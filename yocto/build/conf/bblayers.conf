## yocto/build/conf/bblayers.conf
```bitbake
# POKY_BBLAYERS_CONF_VERSION is increased each time build/conf/bblayers.conf
# changes incompatibly
POKY_BBLAYERS_CONF_VERSION = "2"

BBPATH = "${TOPDIR}"
BBFILES ?= ""

BBLAYERS ?= " \
  /home/matt/Documents/Projet_Final_Master_2/yocto/poky/meta \
  /home/matt/Documents/Projet_Final_Master_2/yocto/poky/meta-poky \
  /home/matt/Documents/Projet_Final_Master_2/yocto/poky/meta-yocto-bsp \
  /home/matt/Documents/Projet_Final_Master_2/yocto/layers/meta-openembedded/meta-oe \
  /home/matt/Documents/Projet_Final_Master_2/yocto/layers/meta-openembedded/meta-python \
  /home/matt/Documents/Projet_Final_Master_2/yocto/layers/meta-openembedded/meta-networking \
  /home/matt/Documents/Projet_Final_Master_2/yocto/layers/meta-raspberrypi \
  /home/matt/Documents/Projet_Final_Master_2/yocto/layers/meta-qt5 \
  /home/matt/Documents/Projet_Final_Master_2/yocto/layers/meta-watihouse \
  "
```

## yocto/layers/meta-watihouse/conf/layer.conf
```bitbake
# We have a conf and classes directory, add to BBPATH
BBPATH .= ":${LAYERDIR}"

# We have recipes-* directories, add to BBFILES
BBFILES += "${LAYERDIR}/recipes-*/*/*.bb \
            ${LAYERDIR}/recipes-*/*/*.bbappend"

BBFILE_COLLECTIONS += "meta-watihouse"
BBFILE_PATTERN_meta-watihouse = "^${LAYERDIR}/"
BBFILE_PRIORITY_meta-watihouse = "6"

LAYERDEPENDS_meta-watihouse = "core"
LAYERSERIES_COMPAT_meta-watihouse = "kirkstone"
```
